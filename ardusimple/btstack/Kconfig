## ardusimple/btstack/Kconfig
```kconfig
#
# For a description of the syntax of this configuration file,
# see the file kconfig-language.txt in the NuttX tools repository.
#

config ARDUSIMPLE_BTSTACK
	bool "BTStack application"
  depends on BTSTACK
	default n
	---help---
		Enable the btstack application(s).

if ARDUSIMPLE_BTSTACK
choice
	prompt "Application Type"
	default ARDUSIMPLE_BTSTACK_SPP

config ARDUSIMPLE_BTSTACK_GATT
	bool "GATT"

config ARDUSIMPLE_BTSTACK_SPP
	bool "SPP"

config ARDUSIMPLE_BTSTACK_HID
	bool "HID"

config ARDUSIMPLE_BTSTACK_GAP
	bool "GAP"

endchoice # "Application Type"

if ARDUSIMPLE_BTSTACK_GATT

choice
	prompt "GATT Type"
	default ARDUSIMPLE_BTSTACK_GATT_COUNTER

config ARDUSIMPLE_BTSTACK_GATT_COUNTER
	bool "Counter"

config ARDUSIMPLE_BTSTACK_GATT_BROWSER
	bool "Browser"

config ARDUSIMPLE_BTSTACK_GATT_BATT_QUERY
	bool "Battery Query"

config ARDUSIMPLE_BTSTACK_GATT_HEART_RATE_CLIENT
	bool "Heart Rate Client"

config ARDUSIMPLE_BTSTACK_GATT_HEART_RATE_SERVER
	bool "Heart Rate Client"

config ARDUSIMPLE_BTSTACK_GATT_DEVINFO_QUERY
	bool "Device Information Query"

endchoice # "GATT Type"

endif # ARDUSIMPLE_BTSTACK_GATT

if ARDUSIMPLE_BTSTACK_SPP

choice
	prompt "SPP Type"
	default ARDUSIMPLE_BTSTACK_SPP_MAPKIT

config ARDUSIMPLE_BTSTACK_SPP_MAPKIT
	bool "MapKit BR/EDR"

config ARDUSIMPLE_BTSTACK_SPP_NORDIC_LE_MAPKIT
	bool "Mapkit Nordic LE"

config ARDUSIMPLE_BTSTACK_SPP_UBLOX_LE_MAPKIT
	bool "Mapkit u-blox LE"

config ARDUSIMPLE_BTSTACK_SPP_COUNTER
	bool "Counter"

config ARDUSIMPLE_BTSTACK_SPP_UBLOX_LE_COUNTER
	bool "Counter u-blox LE"

config ARDUSIMPLE_BTSTACK_SPP_NORDIC_LE_COUNTER
	bool "Counter Nordic LE"

config ARDUSIMPLE_BTSTACK_SPP_STREAMER
	bool "Streamer"

config ARDUSIMPLE_BTSTACK_SPP_STREAMER_CLIENT
	bool "Streamer Client"

config ARDUSIMPLE_BTSTACK_SPP_NORDIC_LE_STREAMER
	bool "Streamer Nordic LE"

config ARDUSIMPLE_BTSTACK_SPP_FLOWCTRL
	bool "Flow Control"

config ARDUSIMPLE_BTSTACK_SPP_GATT_COUNTER
	bool "SPP & GATT Counter"

config ARDUSIMPLE_BTSTACK_SPP_GATT_STREAMER
	bool "SPP & GATT Streamer"

endchoice # "SPP Type"

endif # ARDUSIMPLE_BTSTACK_SPP

if ARDUSIMPLE_BTSTACK_SPP_MAPKIT || ARDUSIMPLE_BTSTACK_SPP_NORDIC_LE_MAPKIT
config ARDUSIMPLE_BTSTACK_MAPKIT_GNSS_PORT2
	bool "Use GNSS port 2"
	default n
	---help---
		User GNSS port 2 to inject RTCM data.
endif # ARDUSIMPLE_BTSTACK_SPP_MAPKIT || ARDUSIMPLE_BTSTACK_SPP_NORDIC_LE_MAPKIT

if ARDUSIMPLE_BTSTACK_MAPKIT_GNSS_PORT2
config ARDUSIMPLE_BTSTACK_MAPKIT_GNSS_PORT2_PATH
	string "GNSS port 2 path"
	default "/dev/ttyS3"
	---help---
		GNSS port 2 default path.
endif

if ARDUSIMPLE_BTSTACK_HID

choice
	prompt "HID Type"
	default ARDUSIMPLE_BTSTACK_HID_KEYBOARD

config ARDUSIMPLE_BTSTACK_HID_HOST
	bool "Host"

config ARDUSIMPLE_BTSTACK_HID_MOUSE
	bool "Mouse"

config ARDUSIMPLE_BTSTACK_HID_KEYBOARD
	bool "Keyboard"

endchoice # "HID Type"

endif # ARDUSIMPLE_BTSTACK_HID

if ARDUSIMPLE_BTSTACK_GAP

choice
	prompt "GAP Type"
	default ARDUSIMPLE_BTSTACK_GAP_ADVER

config ARDUSIMPLE_BTSTACK_GAP_INQUIRY
	bool "Inquiry"

config ARDUSIMPLE_BTSTACK_GAP_ADVER
	bool "LE Advertisements"

endchoice # "GAP Type"

endif # ARDUSIMPLE_BTSTACK_GAP

config ARDUSIMPLE_BTSTACK_NR_GATT_CLIENTS
	int "GATT maximum client number"
	default 1

config ARDUSIMPLE_BTSTACK_NR_HIDS_CLIENTS
	int "HID maximum client number"
	default 1

config ARDUSIMPLE_BTSTACK_NR_HIDS_HOSTS
	int "HID maximum host number"
	default 1

config ARDUSIMPLE_BTSTACK_NR_SPP_CONNECTIONS
	int "SPP maximum connection number"
	default 1

config ARDUSIMPLE_BTSTACK_NR_RFCOMM_SERVICES
	int "RFCOMM maximum sevice number"
	default 2

config ARDUSIMPLE_BTSTACK_NR_L2CAP_SERVICES
	int "L2CAP maximum sevice number"
	default 3

config ARDUSIMPLE_BTSTACK_PROGNAME
	string "Program name"
	default "btstack"
	---help---
		This is the name of the program that will be used when the NSH ELF
		program is installed.

config ARDUSIMPLE_BTSTACK_PRIORITY
	int "BTStack task priority"
	default 100

config ARDUSIMPLE_BTSTACK_STACKSIZE
	int "BTStack stack size"
	default DEFAULT_TASK_STACKSIZE

endif # ARDUSIMPLE_BTSTACK
```

## ardusimple/button/Kconfig
```kconfig
#
# For a description of the syntax of this configuration file,
# see the file kconfig-language.txt in the NuttX tools repository.
#

config ARDUSIMPLE_BUTTON
	bool "Button service application"
	default n
	---help---
		This application is an service of button device.

if ARDUSIMPLE_BUTTON

config ARDUSIMPLE_BUTTON_DEVPATH
	string "Button device path"
	default "/dev/buttons"
	---help---
		The path to the button device. Default: /dev/buttons

config ARDUSIMPLE_BUTTON_PROGNAME
	string "Program name"
	default "serv_button"
	---help---
		This is the name of the program that will be used when the NSH ELF
		program is installed.

config ARDUSIMPLE_BUTTON_PRIORITY
	int "Task priority"
	default 100

config ARDUSIMPLE_BUTTON_STACKSIZE
	int "Stack size"
	default DEFAULT_TASK_STACKSIZE

endif
```

## ardusimple/charger/Kconfig
```kconfig
config ARDUSIMPLE_CHARGER
	bool "Charger service application"
	default y
  select ARDUSIMPLE_UORB_TOPICS
	---help---
		This application is an service of charger device.

if ARDUSIMPLE_CHARGER

config ARDUSIMPLE_CHARGER_DEVNAME
	string "Charger device name"
	default "/dev/batt0"
	---help---
		Set the charger device name.

config ARDUSIMPLE_CHARGER_PROGNAME
	string "Program name"
	default "serv_charger"
	---help---
		This is the name of the program that will be use when the NSH ELF
		program is installed.

config ARDUSIMPLE_CHARGER_PRIORITY
	int "charger task priority"
	default 100

config ARDUSIMPLE_CHARGER_STACKSIZE
	int "charger stack size"
	default DEFAULT_TASK_STACKSIZE

endif
```

## ardusimple/gpoll/Kconfig
```kconfig
#
# For a description of the syntax of this configuration file,
# see the file kconfig-language.txt in the NuttX tools repository.
#

config ARDUSIMPLE_GPOLL
	bool "GNSS message poll application"
	default n
	---help---
		Poll GNSS messages using named FIFO.

if ARDUSIMPLE_GPOLL

config ARDUSIMPLE_GPOLL_FIFO
	string "FIFO name"
	default "/var/gnss0"

config ARDUSIMPLE_GPOLL_PROGNAME
	string "Program name"
	default "as_gpoll"
	---help---
		This is the name of the program that will be used when the NSH ELF
		program is installed.

config ARDUSIMPLE_GPOLL_PRIORITY
	int "Task priority"
	default 100

config ARDUSIMPLE_GPOLL_STACKSIZE
	int "Stack size"
	default DEFAULT_TASK_STACKSIZE

endif
```

## ardusimple/gserv/Kconfig
```kconfig
#
# For a description of the syntax of this configuration file,
# see the file kconfig-language.txt in the NuttX tools repository.
#

config ARDUSIMPLE_GSERV
	bool "GNSS service application"
	default n
  depends on !SENSORS_UBLOX_GNSS
	select GPSUTILS_MINMEA_LIB
	---help---
		Read GNSS data and share them using named FIFO.

if ARDUSIMPLE_GSERV

config ARDUSIMPLE_GSERV_DEVPATH
	string "GNSS device path"
	default "/dev/ttyS5"
	---help---
		The device path to the GNSS device

config ARDUSIMPLE_GSERV_BAUDRATE
	int "GNSS port Baudrate"
	default 38400
	---help---
		Choose GNSS serial port baudrate.

config ARDUSIMPLE_GSERV_FIFO
	string "FIFO name"
	default "/var/gnss0"

config ARDUSIMPLE_GSERV_PROGNAME
	string "Program name"
	default "as_gserv"
	---help---
		This is the name of the program that will be used when the NSH ELF
		program is installed.

config ARDUSIMPLE_GSERV_PRIORITY
	int "Task priority"
	default 100

config ARDUSIMPLE_GSERV_STACKSIZE
	int "Stack size"
	default DEFAULT_TASK_STACKSIZE

endif
```

## ardusimple/im19ei/Kconfig
```kconfig
#
# For a description of the syntax of this configuration file,
# see the file kconfig-language.txt in the NuttX tools repository.
#

config ARDUSIMPLE_IM19EI
	bool "IM19EI attitude module"
	default n
	---help---
		This application is test for IM19EI attitude module.

if ARDUSIMPLE_IM19EI

config ARDUSIMPLE_IM19EI_PORT1
	string "Port 1 device path"
	default "/dev/ttyS5"
	---help---
		IM19EI port 1 device path.

config ARDUSIMPLE_IM19EI_BAUD1
	int "Port 1 baudrate"
	default 115200
	---help---
		IM19EI port 1 baud rate.

config ARDUSIMPLE_IM19EI_PORT2
	string "Port 2 device path"
	default "/dev/ttyS0"
	---help---
		IM19EI port 2 device path.

config ARDUSIMPLE_IM19EI_BAUD2
	int "Port 2 baudrate"
	default 115200
	---help---
		IM19EI port 2 baud rate.

config ARDUSIMPLE_IM19EI_PROGNAME
	string "Program name"
	default "im19ei_att"
	---help---
		This is the name of the program that will be used when the NSH ELF
		program is installed.

config ARDUSIMPLE_IM19EI_PRIORITY
	int "Task priority"
	default 100

config ARDUSIMPLE_IM19EI_STACKSIZE
	int "Stack size"
	default DEFAULT_TASK_STACKSIZE

endif
```

## ardusimple/leds/Kconfig
```kconfig
#
# For a description of the syntax of this configuration file,
# see the file kconfig-language.txt in the NuttX tools repository.
#

config ARDUSIMPLE_LEDS
	tristate "LED(s) service application"
	default n
	depends on USERLED
  select ARDUSIMPLE_UORB_TOPICS
	---help---
		This application is an service of LED(s) device.

if ARDUSIMPLE_LEDS

config ARDUSIMPLE_LEDS_PROGNAME
	string "Program name"
	default "serv_leds"
	---help---
		This is the name of the program that will be used when the NSH ELF
		program is installed.

config ARDUSIMPLE_LEDS_PRIORITY
	int "LED task priority"
	default 100

config ARDUSIMPLE_LEDS_STACKSIZE
	int "LED stack size"
	default DEFAULT_TASK_STACKSIZE

config ARDUSIMPLE_LEDS_PWMPATH
	string "LED PWM path"
	default "/dev/pwm1"

config ARDUSIMPLE_LEDS_DEVPATH
	string "LED device path"
	default "/dev/userleds"

config ARDUSIMPLE_LEDS_LEDSET
	hex "Subset of LEDs to use"
	default 0x07

endif # ARDUSIMPLE_LEDS
```

## ardusimple/mpoll/Kconfig
```kconfig
#
# For a description of the syntax of this configuration file,
# see the file kconfig-language.txt in the NuttX tools repository.
#

config ARDUSIMPLE_MPOLL
	bool "Message poll application"
	default n
	---help---
		Poll messages using named FIFO.

if ARDUSIMPLE_MPOLL

config ARDUSIMPLE_MPOLL_FIFO
	string "FIFO name"
	default "/var/fifo0"

config ARDUSIMPLE_MPOLL_PROGNAME
	string "Program name"
	default "as_mpoll"
	---help---
		This is the name of the program that will be used when the NSH ELF
		program is installed.

config ARDUSIMPLE_MPOLL_PRIORITY
	int "Task priority"
	default 100

config ARDUSIMPLE_MPOLL_STACKSIZE
	int "Stack size"
	default DEFAULT_TASK_STACKSIZE

endif
```

## ardusimple/msend/Kconfig
```kconfig
#
# For a description of the syntax of this configuration file,
# see the file kconfig-language.txt in the NuttX tools repository.
#

config ARDUSIMPLE_MSEND
	bool "Message send application"
	default n
	---help---
		Send messages using named FIFO.

if ARDUSIMPLE_MSEND

config ARDUSIMPLE_MSEND_FIFO
	string "FIFO name"
	default "/var/fifo0"

config ARDUSIMPLE_MSEND_PROGNAME
	string "Program name"
	default "as_msend"
	---help---
		This is the name of the program that will be used when the NSH ELF
		program is installed.

config ARDUSIMPLE_MSEND_PRIORITY
	int "Task priority"
	default 100

config ARDUSIMPLE_MSEND_STACKSIZE
	int "Stack size"
	default DEFAULT_TASK_STACKSIZE

endif
```

## ardusimple/netconf/Kconfig
```kconfig
#
# For a description of the syntax of this configuration file,
# see the file kconfig-language.txt in the NuttX tools repository.
#

config ARDUSIMPLE_NETCONF
	bool "Network configuration"
	default n
	depends on NETINIT_THREAD

if ARDUSIMPLE_NETCONF

config ARDUSIMPLE_NETCONF_PROGNAME
	string "Program name"
	default "netconf"
	---help---
		This is the name of the program that will be used when the NSH ELF
		program is installed.

config ARDUSIMPLE_NETCONF_PRIORITY
	int "Task priority"
	default 100

config ARDUSIMPLE_NETCONF_STACKSIZE
	int "Stack size"
	default DEFAULT_TASK_STACKSIZE

endif
```

## ardusimple/netlink/Kconfig
```kconfig
#
# For a description of the syntax of this configuration file,
# see the file kconfig-language.txt in the NuttX tools repository.
#

config ARDUSIMPLE_NETLINK
	bool "Network link monitor"
	default n
	depends on NETINIT_THREAD && NETDEV_PHY_IOCTL && NET_UDP
	---help---
		By default the net initialization thread will bring-up the network
		then exit, freeing all of the resources that it required.  This is a
		good behavior for systems with limited memory.

		If this option is selected, however, then the network initialization
		thread will persist forever; it will monitor the network status.  In
		the event that the network goes down (for example, if a cable is
		removed), then the thread will monitor the link status and
		attempt to bring the network back up.  In this case the resources
		required for network initialization are never released.

if ARDUSIMPLE_NETLINK

config ARDUSIMPLE_NETLINK_SIGNO
	int "Notification signal number"
	default 32
	depends on ARCH_PHY_INTERRUPT
	---help---
		The network monitor logic will receive signals when there is any
		change in the link status.  This setting may be used to customize
		that signal number in order to avoid conflicts.

config ARDUSIMPLE_NETLINK_RETRYMSEC
	int "Network bring-up retry period (msec)"
	default 2000
	depends on ARCH_PHY_INTERRUPT
	---help---
		When the network is down, the initialization thread will periodically
		try to bring the network up.  This can be a time consuming operation
		so is done only periodically with that period specified by this
		selection in milliseconds.

config ARDUSIMPLE_NETLINK_PROGNAME
	string "Program name"
	default "netlink"
	---help---
		This is the name of the program that will be used when the NSH ELF
		program is installed.

config ARDUSIMPLE_NETLINK_PRIORITY
	int "Task priority"
	default 100

config ARDUSIMPLE_NETLINK_STACKSIZE
	int "Stack size"
	default DEFAULT_TASK_STACKSIZE

endif
```

## ardusimple/tone/Kconfig
```kconfig
#
# For a description of the syntax of this configuration file,
# see the file kconfig-language.txt in the NuttX tools repository.
#

config ARDUSIMPLE_TONE
	bool "Tone generator application"
	default n
	---help---
		Generate tones using PWM device.

if ARDUSIMPLE_TONE

config ARDUSIMPLE_TONE_DEVPATH
	string "PWM device path"
	default "/dev/pwm0"
	---help---
		The path to the PWM device.  Default: /dev/pwm0

config ARDUSIMPLE_TONE_PROGNAME
	string "Program name"
	default "tone"
	---help---
		This is the name of the program that will be used when the NSH ELF
		program is installed.

config ARDUSIMPLE_TONE_PRIORITY
	int "Task priority"
	default 100

config ARDUSIMPLE_TONE_STACKSIZE
	int "Stack size"
	default DEFAULT_TASK_STACKSIZE

endif
```

## ardusimple/topics/Kconfig
```kconfig
config ARDUSIMPLE_UORB_TOPICS
	bool "uORB Topics"
	default n

if ARDUSIMPLE_UORB_TOPICS

config ARDUSIMPLE_UORB_BATTERY_STATUS
	bool "Battery Status"
	default y

config ARDUSIMPLE_UORB_NETWORK_STATUS
	bool "Network Status"
	default y

config ARDUSIMPLE_UORB_BTSTACK_STATUS
	bool "BTstack Status"
	default y

config ARDUSIMPLE_UORB_RTCM_MESSAGE
	bool "RTCM Message"
	default y

endif
```
