## boot/tinyboot/Kconfig
```kconfig
#
# For a description of the syntax of this configuration file,
# see the file kconfig-language.txt in the NuttX tools repository.
#

menuconfig BOOT_TINYBOOT
	bool "Tiny bootloader"
	default n
	select BCH
	---help---
		Enable support for the minimal NuttX based bootloader.

if BOOT_TINYBOOT

config TINYBOOT_PRIMARY_SLOT_PATH
	string "Application firmware primary image slot path"
	default "/dev/ota0"
	---help---
		The path to the application firmware image primary slot character
		device driver. The image runs from this location.
		Default: /dev/ota0

config TINYBOOT_SECONDARY_SLOT_PATH
	string "Application firmware secondary image slot path"
	default "/dev/img0"
	---help---
		The path to the application firmware image primary slot character
		device driver. This is either update or recovery slot.
		Default: /dev/ota1

config TINYBOOT_TERTIARY_SLOT_PATH
	string "Application firmware tertiary image slot path"
	default "/dev/img1"
	---help---
		The path to the application firmware image primary slot character
		device driver. This is either update or recovery slot.
		Default: /dev/ota2

config TINYBOOT_HEADER_SIZE
	hex "Application firmware image header size"
	default 0x200
	---help---
		Note that this size should be aligned with the program memory write
		page size!

config TINYBOOT_BOOTLOADER
	bool "Build tinyboot bootloader application"
	default n
	select BOARDCTL
	select BOARDCTL_BOOT_IMAGE
	---help---
		This option builds and links a bootloader application. This application
		should be an entry function for NuttX. It checks for possible update/
		revert operation, performs it and boot the correct image.

if TINYBOOT_BOOTLOADER

config TINYBOOT_SWRESET_ONLY
	bool "Perform update/revert only on SW reset"
	default n
	select BOARDCTL_RESET_CAUSE
	---help---
		This option ensures the update/revert is performed only for following
		reset causes:
			BOARDIOC_RESETCAUSE_CPU_SOFT: software reset
			BOARDIOC_RESETCAUSE_CPU_RWDT: watchdog error
			BOARDIOC_RESETCAUSE_PIN: reset button

		This way the board can keep its image (even if not confirmed) during
		for example power shutdown and perform update/revent only if expected
		based on user/maintainer input.

config TINYBOOT_PREVENT_DOWNGRADE
	bool "Perform update only for newer version"
	default n
	---help---
		Tinyboot uses Semantic Version 2.0.0 (without build metadata). By default
		the update is performed for every version that doesn't match the
		currently running one. If TINYBOOT_PREVENT_DOWNGRADE selected, update is
		performed only for newer versions  (according to Semantic Version
		preference rules).

		WARNING: Tinyboot currently implementes preferences only for
		MAJOR.MINOR.PATCH and ignores prerelease.

endif # TINYBOOT_BOOTLOADER

endif # BOOT_TINYBOOT
```

## crypto/xxtea/Kconfig
```kconfig
#
# For a description of the syntax of this configuration file,
# see the file kconfig-language.txt in the NuttX tools repository.
#

config XXTEA
	bool "eXtended TEA Support"
	---help---
		This option enables the eXtended TEA cryptography library.

if XXTEA

config XXTEA_VERSION
	string "XXTEA Version"
	default "1.0.1"

endif # XXTEA
```

## examples/bno055/Kconfig
```kconfig
#
# For a description of the syntax of this configuration file,
# see the file kconfig-language.txt in the NuttX tools repository.
#

config EXAMPLES_BNO055
	tristate "BNO055 smart sensor example"
	default n
	depends on SENSORS_BNO055
	---help---
		Enable the BNO055 example

if EXAMPLES_BNO055

config EXAMPLES_BNO055_DEVPATH
	string "BNO055 device path"
	default "/dev/imu0"
	---help---
		The default path to the BNO055 device. Default: /dev/imu0

config EXAMPLES_BNO055_PROGNAME
	string "Program name"
	default "bno055"
	---help---
		This is the name of the program that will be used when the NSH ELF
		program is installed.

config EXAMPLES_BNO055_PRIORITY
	int "BNO055 task priority"
	default 100

config EXAMPLES_BNO055_STACKSIZE
	int "BNO055 stack size"
	default DEFAULT_TASK_STACKSIZE

endif
```

## examples/bno085/Kconfig
```kconfig
#
# For a description of the syntax of this configuration file,
# see the file kconfig-language.txt in the NuttX tools repository.
#

config EXAMPLES_BNO085
	tristate "BNO085 smart sensor example"
	default n
	depends on SENSORS_BNO085
	---help---
		Enable the BNO085 example

if EXAMPLES_BNO085

config EXAMPLES_BNO085_DEVPATH
	string "BNO085 device path"
	default "/dev/imu0"
	---help---
		The default path to the BNO085 device. Default: /dev/imu0

config EXAMPLES_BNO085_PROGNAME
	string "Program name"
	default "bno085"
	---help---
		This is the name of the program that will be used when the NSH ELF
		program is installed.

config EXAMPLES_BNO085_PRIORITY
	int "BNO085 task priority"
	default 100

config EXAMPLES_BNO085_STACKSIZE
	int "BNO085 stack size"
	default DEFAULT_TASK_STACKSIZE

endif
```

## examples/gps/Kconfig
```kconfig
#
# For a description of the syntax of this configuration file,
# see the file kconfig-language.txt in the NuttX tools repository.
#

config EXAMPLES_GPS
	tristate "GPS example"
	default n
  depends on !SENSORS_UBLOX_GNSS
	select GPSUTILS_MINMEA_LIB
	---help---
		Enable the gps test example

if EXAMPLES_GPS

config EXAMPLES_GPS_PROGNAME
	string "Program name"
	default "gps"
	---help---
		This is the name of the program that will be used when the NSH ELF
		program is installed.

config EXAMPLES_GPS_PRIORITY
	int "GPS task priority"
	default 100

config EXAMPLES_GPS_STACKSIZE
	int "GPS stack size"
	default DEFAULT_TASK_STACKSIZE

config EXAMPLES_GPS_DEVPATH
	string "GPS device path"
	default "/dev/ttyS5"
	---help---
		The device path to the GPS device

config EXAMPLES_GPS_BAUDRATE
	int "GPS port Baudrate"
	default 38400
	---help---
		Choose GPS serial port baudrate.

endif
```

## examples/mongoose/Kconfig
```kconfig
#
# For a description of the syntax of this configuration file,
# see the file kconfig-language.txt in the NuttX tools repository.
#

config EXAMPLES_MONGOOSE
	tristate "Mongoose examples"
	default n
	depends on NETUTILS_MONGOOSE
	---help---
		Enable the Mongoose examples.

if EXAMPLES_MONGOOSE

config EXAMPLES_MONGOOSE_HTTPD
	tristate "Mongoose Simple"
	default n
	depends on NETUTILS_MONGOOSE
	---help---
		Enable the Mongoose simple web server application.

config EXAMPLES_MONGOOSE_WEBSOCKD
	tristate "Mongoose Websocket"
	default n
	depends on NETUTILS_MONGOOSE
	---help---
		Enable the Mongoose websocket server application.

config EXAMPLES_MONGOOSE_SMARTANT
	tristate "Mongoose Smart Antenna"
	default n
	depends on NETUTILS_MONGOOSE
	---help---
		Enable the Mongoose smart antenna server application.

if EXAMPLES_MONGOOSE_SMARTANT

choice
	prompt "GNSS message type"
	default EXAMPLES_MONGOOSE_SMARTANT_UORB

config EXAMPLES_MONGOOSE_SMARTANT_UORB
	bool "Use uORB"
	select UORB

config EXAMPLES_MONGOOSE_SMARTANT_FIFO
	bool "Use FIFO"
  select PIPES

endchoice # GNSS message type

endif # EXAMPLES_MONGOOSE_SMARTANT

config EXAMPLES_MONGOOSE_DASHBOARD
	tristate "Mongoose Dashboard"
	default n
	depends on NETUTILS_MONGOOSE
	---help---
		Enable the Mongoose Dashboard server application.

if EXAMPLES_MONGOOSE_DASHBOARD

config EXAMPLES_MONGOOSE_DASHBOARD_OTAPATH
	string "Dashboard OTA path"
	default "/dev/img0"

endif # EXAMPLES_MONGOOSE_DASHBOARD

config EXAMPLES_MONGOOSE_PRIORITY
	int "Mongoose task priority"
	default 100

config EXAMPLES_MONGOOSE_STACKSIZE
	int "Mongoose stack size"
	default 8192

endif
```

## examples/simple_led/Kconfig
```kconfig
#
# For a description of the syntax of this configuration file,
# see the file kconfig-language.txt in the NuttX tools repository.
#

config EXAMPLES_SIMPLE_LED
	tristate "Simple LED example"
	default n
	---help---
		Enable the simple LED example

if EXAMPLES_SIMPLE_LED

config EXAMPLES_SIMPLE_LED_PROGNAME
	string "Program name"
	default "simple_led"

config EXAMPLES_SIMPLE_LED_PRIORITY
	int "Simple LED task priority"
	default 100

config EXAMPLES_SIMPLE_LED_STACKSIZE
	int "Simple LED stack size"
	default DEFAULT_TASK_STACKSIZE

endif
```

## gmtcnt/etherip/Kconfig
```kconfig
#
# For a description of the syntax of this configuration file,
# see the file kconfig-language.txt in the NuttX tools repository.
#

config GMTCNT_ETHERIP
	bool "EtherNet/IP™ application"
	default n
	depends on ODVA_ETHERIP
	---help---
		Enable sample application for EtherNet/IP™ protocol.

if GMTCNT_ETHERIP

config GMTCNT_ETHERIP_PROGNAME
	string "Program name"
	default "etherip"
	---help---
		This is the name of the program that will be used when the NSH ELF
		program is installed.

config GMTCNT_ETHERIP_PRIORITY
	int "Task priority"
	default 100

config GMTCNT_ETHERIP_STACKSIZE
	int "Task stack size"
	default DEFAULT_TASK_STACKSIZE

endif # GMTCNT_ETHERIP
```

## gmtcnt/fpga/Kconfig
```kconfig
#
# For a description of the syntax of this configuration file,
# see the file kconfig-language.txt in the NuttX tools repository.
#

config GMTCNT_FPGA
	tristate "FPGA dedicated tools"
	default n
	depends on SPI
	depends on SPI_TRION
	---help---
		Enable support for Efinix Trion FPGA.

if GMTCNT_FPGA

config GMTCNT_FPGA_LOAD
	bool "FPGA bitstream loader"
	default n
	---help---
		This application is bitstream loader for the Efinix Trion FPGA.

if GMTCNT_FPGA_LOAD
config GMTCNT_FPGA_BUFSIZE
	int "FPGA buffer size"
	default 1024
	---help---
		The default buffer size for FPGA bitstream loading.
endif # GMTCNT_FPGA_LOAD

config GMTCNT_FPGA_CTRL
	bool "FPGA logic controller"
	default n
	---help---
		This application is logic controller for the Efinix Trion FPGA.

config GMTCNT_FPGA_DEVNAME
	string "FPGA device path"
	default "/dev/trion0"
	---help---
		The default path to the FPGA device.

config GMTCNT_FPGA_PRIORITY
	int "Task priority"
	default 100

config GMTCNT_FPGA_STACKSIZE
	int "Task stack size"
	default DEFAULT_TASK_STACKSIZE

endif # GMTCNT_FPGA
```

## gmtcnt/leds/Kconfig
```kconfig
#
# For a description of the syntax of this configuration file,
# see the file kconfig-language.txt in the NuttX tools repository.
#

config GMTCNT_LEDS
	tristate "LED(s) service application"
	default n
	depends on USERLED
	select GMTCNT_UORB_TOPICS
	---help---
		This application is an service of LED(s) device.

if GMTCNT_LEDS

config GMTCNT_LEDS_PROGNAME
	string "Program name"
	default "serv_leds"
	---help---
		This is the name of the program that will be used when the NSH ELF
		program is installed.

config GMTCNT_LEDS_PRIORITY
	int "LED task priority"
	default 100

config GMTCNT_LEDS_STACKSIZE
	int "LED stack size"
	default DEFAULT_TASK_STACKSIZE

endif # GMTCNT_LEDS
```

## gmtcnt/netconf/Kconfig
```kconfig
#
# For a description of the syntax of this configuration file,
# see the file kconfig-language.txt in the NuttX tools repository.
#

config GMTCNT_NETCONF
	bool "Network configuration"
	default n
	depends on NETINIT_THREAD

if GMTCNT_NETCONF

config GMTCNT_NETCONF_PROGNAME
	string "Program name"
	default "netconf"
	---help---
		This is the name of the program that will be used when the NSH ELF
		program is installed.

config GMTCNT_NETCONF_PRIORITY
	int "Task priority"
	default 100

config GMTCNT_NETCONF_STACKSIZE
	int "Stack size"
	default DEFAULT_TASK_STACKSIZE

endif
```

## gmtcnt/plclogic/Kconfig
```kconfig
#
# For a description of the syntax of this configuration file,
# see the file kconfig-language.txt in the NuttX tools repository.
#

config GMTCNT_PLCLOGIC
	bool "PLC core logic"
	default n
	select BCH
	select LIBFLASH
	---help---
		Enable support for the PLC core logic.

if GMTCNT_PLCLOGIC

config GMTCNT_PLCLOGIC_PRIMARY_SLOT_PATH
	string "Firmware image slot path"
	default "/dev/ota0"
	---help---
		The path to the kernel firmware image slot character
		device driver. The image runs from this location.
		Default: /dev/ota0

config GMTCNT_PLCLOGIC_SECONDARY_SLOT_PATH
	string "Application image slot path(1)"
	default "/dev/ota1"
	---help---
		The path to the application image(1) slot character
		device driver. The image runs from this location.
		Default: /dev/ota1

config GMTCNT_PLCLOGIC_TERTIARY_SLOT_PATH
	string "Application image slot path(2)"
	default "/dev/ota2"
	---help---
		The path to the application image(2) slot character
		device driver. The image runs from this location.
		Default: /dev/ota2

config GMTCNT_PLCLOGIC_HEADER_SIZE
	hex "Image header size"
	default 0x200
	---help---
		Note that this size should be aligned with the program memory write
		page size!

config GMTCNT_PLCLOGIC_PROGNAME
	string "Program name"
	default "logic_load"
	---help---
		This is the name of the program that will be used when the NSH ELF
		program is installed.

config GMTCNT_PLCLOGIC_PRIORITY
	int "Task priority"
	default 100

config GMTCNT_PLCLOGIC_STACKSIZE
	int "Stack size"
	default DEFAULT_TASK_STACKSIZE

endif # GMTCNT_PLCLOGIC
```
