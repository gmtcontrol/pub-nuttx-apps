## gmtcnt/profinet/Kconfig
```kconfig
#
# For a description of the syntax of this configuration file,
# see the file kconfig-language.txt in the NuttX tools repository.
#

config GMTCNT_PROFINET
	bool "Profinet™ device application"
	default n
	depends on RTLABS_PROFINET
	---help---
		Enable sample application for Profinet™ device protocol.

if GMTCNT_PROFINET

config GMTCNT_PROFINET_PROGNAME
	string "Program name"
	default "profinet"
	---help---
		This is the name of the program that will be used when the NSH ELF
		program is installed.

config GMTCNT_PROFINET_PRIORITY
	int "Task priority"
	default 100

config GMTCNT_PROFINET_STACKSIZE
	int "Task stack size"
	default DEFAULT_TASK_STACKSIZE

endif # GMTCNT_PROFINET
```

## gmtcnt/soem/Kconfig
```kconfig
#
# For a description of the syntax of this configuration file,
# see the file kconfig-language.txt in the NuttX tools repository.
#

config GMTCNT_SOEM
	bool "EtherCAT™ applications"
	default n
	depends on RTLABS_SOEM
	---help---
		Enable application(s) for EtherCAT™ protocol.

if GMTCNT_SOEM

config GMTCNT_SOEM_SDXEC
	bool "SDxEC servo control"
	default n

config GMTCNT_SOEM_PRIORITY
	int "Task priority"
	default 225

config GMTCNT_SOEM_STACKSIZE
	int "Task stack size"
	default 8192

endif # GMTCNT_SOEM
```

## gmtcnt/topics/Kconfig
```kconfig
config GMTCNT_UORB_TOPICS
	bool "uORB Topics"
	default n

if GMTCNT_UORB_TOPICS

config GMTCNT_UORB_SYSTEM_STATUS
	bool "System Status"
	default y

config GMTCNT_UORB_NETWORK_STATUS
	bool "Network Status"
	default y

config GMTCNT_UORB_BTSTACK_STATUS
	bool "BTstack Status"
	default n

endif
```

## imarine/adc/Kconfig
```kconfig
#
# For a description of the syntax of this configuration file,
# see the file kconfig-language.txt in the NuttX tools repository.
#

config IMARINE_ADC_READ
	bool "ADC data read service application"
	default n
	---help---
		Read the memory mapped ADC data.

if IMARINE_ADC_READ

config IMARINE_ADC_MEMADDR
	hex "ADC device memory address"
	default 0xE0000000
	---help---
		Memory address of ADC device.

config IMARINE_ADC_PROGNAME
	string "Program name"
	default "adc_read"
	---help---
		This is the name of the program that will be used when the NSH ELF
		program is installed.

config IMARINE_ADC_PRIORITY
	int "Task priority"
	default 100

config IMARINE_ADC_STACKSIZE
	int "Stack size"
	default DEFAULT_TASK_STACKSIZE

endif
```

## industry/etherip/Kconfig
```kconfig
#
# For a description of the syntax of this configuration file,
# see the file kconfig-language.txt in the NuttX tools repository.
#

config ODVA_ETHERIP
	bool "OpENer EtherNet/IP™ library"
	default n
	---help---
		OpENer is an EtherNet/IP™ stack for I/O adapter devices; 
		supports multiple I/O and explicit connections; 
		includes objects and services to make EtherNet/IP™-compliant products 
		defined in THE ETHERNET/IP SPECIFICATION and published by 
		ODVA (http://www.odva.org).

if ODVA_ETHERIP

config ODVA_ETHERIP_VERSION
	string "Version"
	default "2.3"
	---help---
		OpENer version.

config ODVA_ETHERIP_VENDORID
	int "Vendor ID"
	default 1

config ODVA_ETHERIP_DEVTYPE
	int "Device type"
	default 12

config ODVA_ETHERIP_DEVNAME
	string "Device name"
	default "GLC23X"

config ODVA_ETHERIP_DEVREV
	hex "Device revision"
	default 0x0100

config ODVA_ETHERIP_PRODCODE
	int "Product code"
	default 65001

config ODVA_ETHERIP_BUFSIZE
	int "Ethernet buffer size"
	default 512

endif
```

## industry/profinet/Kconfig
```kconfig
#
# For a description of the syntax of this configuration file,
# see the file kconfig-language.txt in the NuttX tools repository.
#

config RTLABS_PROFINET
	bool "ProfiNet™ device library"
	default n
	---help---
		ProfiNet™ stack for I/O devices.

if RTLABS_PROFINET

config RTLABS_PROFINET_VERSION
	string "Version"
	default "1.0.0"
	---help---
		ProfiNet™ version.

config RTLABS_PROFINET_SNMP
	bool "SNMP support"
	default n

endif
```

## industry/soem/Kconfig
```kconfig
#
# For a description of the syntax of this configuration file,
# see the file kconfig-language.txt in the NuttX tools repository.
#

config RTLABS_SOEM
	bool "EtherCAT™ master library"
	default n
	depends on NET_PKT
	---help---
		Simple Open EtherCAT™ master library.

if RTLABS_SOEM

config RTLABS_SOEM_VERSION
	string "Version"
	default "1.4.0"
	---help---
		EtherCAT™ master library version.

endif
```

## mlearning/tflite/Kconfig
```kconfig
#
# For a description of the syntax of this configuration file,
# see the file kconfig-language.txt in the NuttX tools repository.
#

config TFLITE_MICRO
	bool "Tensorflow Lite Micro"
	default n
	---help---
	  TensorFlow Lite for Microcontrollers.

if TFLITE_MICRO

config TFLITE_MICRO_VER
	string "Tensorflow Lite Micro version"
	default "main"

endif # TFLITE_MICRO
```

## netutils/mongoose/Kconfig
```kconfig
#
# For a description of the syntax of this configuration file,
# see the file kconfig-language.txt in the NuttX tools repository.
#

config NETUTILS_MONGOOSE
	bool "Mongoose library"
	default n
	---help---
		Mongoose is a network library for C/C++. It provides event-driven
		non-blocking APIs for TCP, UDP, HTTP, WebSocket, MQTT, and other
		protocols.

if NETUTILS_MONGOOSE

config MONGOOSE_VERSION
	string "Version"
	default "7.16"

config MONGOOSE_SSI
	bool "SSI support"
	default y

if MONGOOSE_SSI

config MONGOOSE_SSI_BUFSIZE
	int "SSI suffer size"
	default 256

endif # MONGOOSE_SSI

config MONGOOSE_IOSIZE
  int "I/O buffer size"
  default 2048

config MONGOOSE_PATHSIZE
  int "Path buffer size"
  default 256

config MONGOOSE_NONBLOCKING
  bool "Non-blocking message"
  default n

config MONGOOSE_OTA
	bool "OTA support"
	default y

if MONGOOSE_OTA
choice
	prompt "OTA type"
	default MONGOOSE_OTA_CUSTOM

config MONGOOSE_OTA_CUSTOM
	bool "Custom"

endchoice # "OTA type"

endif # MONGOOSE_OTA

config MONGOOSE_TLS
	bool "TLS support"
	default n

if MONGOOSE_TLS

choice
	prompt "TLS Type"
	default MONGOOSE_TLS_BUILTIN

config MONGOOSE_TLS_BUILTIN
	bool "Builtin"

config MONGOOSE_TLS_MBED
	bool "MbedTLS"

config MONGOOSE_TLS_OPENSSL
	bool "OpenSSL"

config MONGOOSE_TLS_WOLFSSL
	bool "WolfSSL"

endchoice

endif # MONGOOSE_TLS

endif # NETUTILS_MONGOOSE
```

## system/xmodem/Kconfig
```kconfig
#
# For a description of the syntax of this configuration file,
# see the file kconfig-language.txt in the NuttX tools repository.
#

config SYSTEM_XMODEM
	tristate "XMODEM"
	---help---
		Enable support for xmodem.

if SYSTEM_XMODEM

config SYSTEM_XMODEM_STACKSIZE
	int "xmodem stack size"
	default DEFAULT_TASK_STACKSIZE
	---help---
		The size of stack allocated for the xmodem task.

config SYSTEM_XMODEM_PRIORITY
	int "xmodem priority"
	default 100
	---help---
		The priority of the xmodem task.

config SYSTEM_XMODEM_DEBUG
	bool "xmodem debug"
	default n

config SYSTEM_XMODEM_DEBUG_FILEPATH
	string "save xmodem debug log path"
	depends on SYSTEM_XMODEM_DEBUG
	default "/tmp/xmodem"

endif
```

## wireless/bluetooth/btstack/Kconfig
```kconfig
config BTSTACK
	bool "Bluekitchen BR/EDR+LE Stack"
	default n
	---help---
		Enable Bluekitchen BR/EDR+LE stack.

if BTSTACK

config BTSTACK_VERSION
	string "Version"
	default "1.6.1"
	---help---
		BTStack version.

config BTSTACK_BLE
	bool "BTStack BLE"
	default n

if BTSTACK_BLE

config BTSTACK_BLE_GATT
	bool "BLE GATT Services"
	default n

config BTSTACK_BLE_SECURE_CONNECTIONS
	bool "BLE secure connnection"
	default n

config BTSTACK_BLE_ATT_DELAYED_RESP
	bool "ATT delayed response"
	default n

config BTSTACK_NVM_NUM_DEVICE_DB_ENTRIES
	int "Number of LE device DB entries"
	default 2
	---help---
		Max number of LE Device DB entries that can be stored.

menu "BLE roles"

config BTSTACK_BLE_CENTRAL
	bool "Central role"
	default n

config BTSTACK_BLE_PERIPHERAL
	bool "Peripheral role"
	default n

endmenu # "BLE role configuration"

endif # BTSTACK_BLE

config BTSTACK_EDR
	bool "BTStack BR/EDR"
	default n

if BTSTACK_EDR

config BTSTACK_GATT_OVER_CLASSIC
	bool "Gatt over classic"
	default n

config BTSTACK_LOCAL_NAME
	bool "Local name support"
	default n

config BTSTACK_NVM_NUM_LINK_KEYS
	int "Number of classic link keys"
	default 2
	---help---
		Max number of Classic Link Keys that can be stored.

config BTSTACK_L2CAP_ENHANCED_RETRANSMISSION_MODE
	bool "Enable Enhanced Retransmission Mode for L2CAP Channels"
	default n

if BTSTACK_L2CAP_ENHANCED_RETRANSMISSION_MODE
config BTSTACK_L2CAP_ENHANCED_RETRANSMISSION_MODE_RFCOMM
	bool "Enable Enhanced Retransmission Mode for RFCOMM"
	default n
endif # BTSTACK_L2CAP_ENHANCED_RETRANSMISSION_MODE

endif # BTSTACK_EDR

config BTSTACK_MESH
	bool "Mesh Network"
	default n

if BTSTACK_MESH

config BTSTACK_MESH_GATT
	bool "Mesh GATT Services"
	default n

endif # BTSTACK_MESH

config BTSTACK_AUDIO
	bool "BTStack audio support"
	default n

if BTSTACK_AUDIO

choice
	prompt "SCO data route"
	default BTSTACK_SCO_OVER_HCI

config BTSTACK_SCO_OVER_HCI
	bool "Routed over HCI"

config BTSTACK_SCO_OVER_PCM
	bool "Routed over PCM"

endchoice # "SCO data route"

endif # BTSTACK_AUDIO

config BTSTACK_SOFTWARE_AES128
	bool "Software AES-128 support"
	default n

menu "Log Output"

config BTSTACK_LOG_INFO
	bool "Info log"
  depends on BTSTACK_PRINTF_HEXDUMP
	default n

config BTSTACK_LOG_DEBUG
	bool "Debug log"
  depends on BTSTACK_PRINTF_HEXDUMP
	default n

config BTSTACK_LOG_ERROR
	bool "Error log"
  depends on BTSTACK_PRINTF_HEXDUMP
	default n

endmenu # "Log Output"

config BTSTACK_PRINTF_HEXDUMP
	bool "Hex dump on stdout"
	default n

config BTSTACK_HCI_ACL_PAYLOAD_SIZE
	int "HCI payload size"
	default 1695

config BTSTACK_HCI_INCOMING_PRE_BUFFER_SIZE
	int "HCI incoming buffer size"
	default 14

config BTSTACK_HCI_OUTGOING_PRE_BUFFER_SIZE
	int "HCI outgoing buffer size"
	default 4

config BTSTACK_ASSERT
	bool "Assertion usage"
	default n

config BTSTACK_MALLOC
	bool "Dynamic memory usage"
	default y

config BTSTACK_STDIN
	bool "Standard input usage"
	default y

config BTSTACK_POSIX_TIME
	bool "Posix time usage"
	default y

config BTSTACK_POSIX_FILEIO
	bool "Posix file I/O usage"
	default n

if BTSTACK_POSIX_TIME

config BTSTACK_MONOTONIC_CLOCK
	bool "Monotonic clock usage"
	default y

endif # BTSTACK_POSIX_TIME

endif # BTSTACK
```
